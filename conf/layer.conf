## conf/layer.conf
```bitbake
# We have a conf and classes directory, add to BBPATH
BBPATH .= ":${LAYERDIR}"

# We have recipes-* directories, add to BBFILES
BBFILES += "${LAYERDIR}/recipes-*/*/*.bb \
            ${LAYERDIR}/recipes-*/*/*.bbappend"

BBFILE_COLLECTIONS += "meta-wireguard-compat"
BBFILE_PATTERN_meta-wireguard-compat = "^${LAYERDIR}/"
BBFILE_PRIORITY_meta-wireguard-compat = "6"

LAYERDEPENDS_meta-wireguard-compat = "core"
LAYERSERIES_COMPAT_meta-wireguard-compat = "gatesgarth"
```
